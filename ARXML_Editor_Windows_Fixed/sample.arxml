AUTOSAR XML (schema 4-7-0)
package /RootPackage
  application sw component type TestAppComponent  # A test application component
    provide port TestPort: provided-interface=TestInterface  # A test provider port
  sender receiver interface TestInterface  # A test sender-receiver interface
    data TestData: type=TestDataType  # Test data element
